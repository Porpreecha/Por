/* Overlay สำหรับ shield my_7x5 */
#include <dt-bindings/zmk/keys.h>
#include <behaviors.dtsi>

/ {
    leds {
        compatible = "zmk,led-apa102";
        label = "RGB";
        #led-cells = <3>;
        pin_clk = <&gpio0 18 GPIO_ACTIVE_HIGH>;
        pin_data = <&gpio0 19 GPIO_ACTIVE_HIGH>;
        led_count = <35>; /* 7x5 */
    };
};
