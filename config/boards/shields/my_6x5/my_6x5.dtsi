/ {
    chosen {
        zmk,kscan = &kscan0;
    };

     kscan0: kscan {
        compatible = "zmk,kscan-gpio-matrix";
        diode-direction = "col2row";

        row-gpios = <&gpio0 0 (GPIO_ACTIVE_HIGH | GPIO_PULL_DOWN)>,
                    <&gpio0 1 (GPIO_ACTIVE_HIGH | GPIO_PULL_DOWN)>,
                    <&gpio0 2 (GPIO_ACTIVE_HIGH | GPIO_PULL_DOWN)>,
                    <&gpio0 3 (GPIO_ACTIVE_HIGH | GPIO_PULL_DOWN)>,
                    <&gpio0 4 (GPIO_ACTIVE_HIGH | GPIO_PULL_DOWN)>,
                    <&gpio0 5 (GPIO_ACTIVE_HIGH | GPIO_PULL_DOWN)>;

        col-gpios = <&gpio1 0 GPIO_ACTIVE_HIGH>,
                    <&gpio1 1 GPIO_ACTIVE_HIGH>,
                    <&gpio1 2 GPIO_ACTIVE_HIGH>,
                    <&gpio1 3 GPIO_ACTIVE_HIGH>,
                    <&gpio1 4 GPIO_ACTIVE_HIGH>;
    };
};
